## sdkconfig.defaults.esp32s3
```kconfig
# ESP32-S3 Speech Command Recognition Config
# Optimized for ESP32-S3, supports wake-up and command recognition
# Uses INMP441 mic and MAX98357A amplifier
#
CONFIG_IDF_TARGET="esp32s3"

# Flash Config - 16MB Flash for speech model storage
CONFIG_ESPTOOLPY_FLASHMODE_QIO=y
CONFIG_ESPTOOLPY_FLASHSIZE_16MB=y

# Partition Table Config - Custom for large model storage
CONFIG_PARTITION_TABLE_CUSTOM=y
CONFIG_PARTITION_TABLE_CUSTOM_FILENAME="partitions.csv"
CONFIG_PARTITION_TABLE_FILENAME="partitions.csv"
CONFIG_PARTITION_TABLE_OFFSET=0x8000
CONFIG_PARTITION_TABLE_MD5=y

# ESP-SR Speech Recognition Config
# Model stored in Flash (recommended for fast boot)
CONFIG_MODEL_IN_FLASH=y

# Audio Frontend Config
CONFIG_AFE_INTERFACE_V1=y
CONFIG_SR_NSN_WEBRTC=y
CONFIG_SR_VADN_VADNET1_MEDIUM=y

# Wake Word Config - Default: "Ni Hao Xiao Zhi"
CONFIG_SR_WN_WN9_NIHAOXIAOZHI_TTS=y
CONFIG_BT_ENABLED=y
CONFIG_BT_NIMBLE_ENABLED=y

# Command Recognition Config - MultiNet7 Chinese model (latest)
CONFIG_SR_MN_CN_MULTINET7_QUANT=y
CONFIG_SR_MN_EN_NONE=y

# CPU Frequency - 240MHz for speech processing performance
CONFIG_ESP_DEFAULT_CPU_FREQ_MHZ_240=y

# Cache Config - Optimize for speech processing
CONFIG_ESP32S3_INSTRUCTION_CACHE_32KB=y
CONFIG_ESP32S3_INSTRUCTION_CACHE_8WAYS=y
CONFIG_ESP32S3_INSTRUCTION_CACHE_LINE_32B=y
CONFIG_ESP32S3_DATA_CACHE_64KB=y
CONFIG_ESP32S3_DATA_CACHE_8WAYS=y
CONFIG_ESP32S3_DATA_CACHE_LINE_64B=y

# PSRAM Config - 8MB external PSRAM for model loading
CONFIG_SPIRAM=y
CONFIG_SPIRAM_MODE_OCT=y
CONFIG_SPIRAM_TYPE_AUTO=y
CONFIG_SPIRAM_SPEED_80M=y
CONFIG_SPIRAM_BOOT_INIT=y
CONFIG_SPIRAM_USE_MALLOC=y
CONFIG_SPIRAM_MALLOC_ALWAYSINTERNAL=4096
CONFIG_SPIRAM_MALLOC_RESERVE_INTERNAL=49152

# System Task Config - Sufficient stack for speech processing
CONFIG_ESP_SYSTEM_EVENT_TASK_STACK_SIZE=4096
CONFIG_ESP_MAIN_TASK_STACK_SIZE=10240
CONFIG_ESP_MAIN_TASK_AFFINITY_CPU0=y

# FreeRTOS Config
CONFIG_FREERTOS_HZ=1000
CONFIG_FREERTOS_CHECK_STACKOVERFLOW_CANARY=y

# Compiler Optimization - Optimize for code size
CONFIG_COMPILER_OPTIMIZATION_SIZE=y
CONFIG_COMPILER_OPTIMIZATION_ASSERTIONS_ENABLE=y
CONFIG_COMPILER_ORPHAN_SECTIONS_PLACE=y

# Memory Management - Optimize for real-time performance
CONFIG_PERIPH_CTRL_FUNC_IN_IRAM=y
CONFIG_GDMA_CTRL_FUNC_IN_IRAM=y

# System Error Handling
CONFIG_ESP_SYSTEM_PANIC_PRINT_REBOOT=y

# Log Config - Info level for debugging
CONFIG_LOG_DEFAULT_LEVEL_INFO=y
CONFIG_LOG_MAXIMUM_EQUALS_DEFAULT=y

# I2S Config - Stable audio data transmission
CONFIG_SPI_MASTER_ISR_IN_IRAM=y
CONFIG_SPI_SLAVE_ISR_IN_IRAM=y
```
